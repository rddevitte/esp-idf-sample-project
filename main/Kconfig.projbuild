## main/Kconfig.projbuild
```kconfig
menu "Project-specific configuration"

    orsource "$IDF_PATH/examples/common_components/env_caps/$IDF_TARGET/Kconfig.env_caps"

    config BLINK_LED_GPIO_PIN
        int "Blink GPIO number"
        range ENV_GPIO_RANGE_MIN ENV_GPIO_OUT_RANGE_MAX
        default 16
        help
            GPIO pin number (IOxx) to blink on and off the LED attached to.

    config WAIT_PERIOD_MS
        int "Waiting period in ms"
        range 10 3600000
        default 1000
        help
            Define the waiting period in milliseconds.

endmenu
```
